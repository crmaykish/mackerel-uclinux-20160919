## lib/libqmi/Kconfig
```kconfig
config LIB_LIBQMI
	bool 'libqmi'
	help
	  QMI library

config LIB_LIBQMI_QMICLI
	bool 'qmicli'
	depends on LIB_LIBQMI
	help
	  The qmicli command

config LIB_LIBQMI_QMI_NETWORK
	bool 'qmi-network'
	depends on LIB_LIBQMI
	help
	  The qmi-network command
```

## linux/arch/m68k/68000/mackerel/Kconfig
```kconfig
menuconfig MACKEREL
	bool "Mackerel-68k board support."
	depends on M68000
	help
	  Support for the Mackerel series of boards.

menuconfig MACKEREL_08
	bool "Mackerel-08 board support."
	depends on MACKEREL
	help
	  Support for the Mackerel-08 board.

menuconfig MACKEREL_10
	bool "Mackerel-10 board support."
	depends on MACKEREL
	help
	  Support for the Mackerel-10 board.
```

## linux/arch/m68k/herring/Kconfig
```kconfig
menuconfig HERRING
	bool "Herring-8 board support."
	depends on M68000
	help
	  Support for the Herring-8 68k board.
```

## user/wpa_supplicant/Kconfig
```kconfig
config USER_WPA_SUPPLICANT
	bool "wpa_supplicant"
	help
	  Support for advanved wireless encryption standards.

config USER_WPA_PASSPHRASE
	bool "wpa_passphrase"
	help
	  Support for advanved wireless encryption standard config generation.
```
